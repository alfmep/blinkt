/dts-v1/;
/plugin/;

/ {
	compatible = "brcm,bcm2835";

	fragment@0 {
		target-path = "/";
		__overlay__ {
			blinkt_leds: blinkt_leds {
				compatible = "pimoroni,blinkt";
				status = "okay";
				blinkt-clk-gpios = <&gpio 24 0>;
				blinkt-dat-gpios = <&gpio 23 0>;
				blinkt-name-prefix = "blinkt";
				blinkt-0-rgb = /bits/ 8 <0x0 0x0 0x0>; /* red, green, blue */
				blinkt-1-rgb = /bits/ 8 <0x0 0x0 0x0>;
				blinkt-2-rgb = /bits/ 8 <0x0 0x0 0x0>;
				blinkt-3-rgb = /bits/ 8 <0x0 0x0 0x0>;
				blinkt-4-rgb = /bits/ 8 <0x0 0x0 0x0>;
				blinkt-5-rgb = /bits/ 8 <0x0 0x0 0x0>;
				blinkt-6-rgb = /bits/ 8 <0x0 0x0 0x0>;
				blinkt-7-rgb = /bits/ 8 <0x0 0x0 0x0>;
				blinkt-0-trigger = "none";
				blinkt-1-trigger = "none";
				blinkt-2-trigger = "none";
				blinkt-3-trigger = "none";
				blinkt-4-trigger = "none";
				blinkt-5-trigger = "none";
				blinkt-6-trigger = "none";
				blinkt-7-trigger = "none";
			};
		};
	};

	__overrides__ {
		prefix = <&blinkt_leds>,"blinkt-name-prefix";

		clk_pin = <&blinkt_leds>,"blinkt-clk-gpios:4";
		dat_pin = <&blinkt_leds>,"blinkt-dat-gpios:4";

		t0 = <&blinkt_leds>,"blinkt-0-trigger";
		t1 = <&blinkt_leds>,"blinkt-1-trigger";
		t2 = <&blinkt_leds>,"blinkt-2-trigger";
		t3 = <&blinkt_leds>,"blinkt-3-trigger";
		t4 = <&blinkt_leds>,"blinkt-4-trigger";
		t5 = <&blinkt_leds>,"blinkt-5-trigger";
		t6 = <&blinkt_leds>,"blinkt-6-trigger";
		t7 = <&blinkt_leds>,"blinkt-7-trigger";

		r0 = <&blinkt_leds>,"blinkt-0-rgb.0";  /* reg */
		g0 = <&blinkt_leds>,"blinkt-0-rgb.1";  /* green */
		b0 = <&blinkt_leds>,"blinkt-0-rgb.2";  /* blue */

		r1 = <&blinkt_leds>,"blinkt-1-rgb.0";
		g1 = <&blinkt_leds>,"blinkt-1-rgb.1";
		b1 = <&blinkt_leds>,"blinkt-1-rgb.2";

		r2 = <&blinkt_leds>,"blinkt-2-rgb.0";
		g2 = <&blinkt_leds>,"blinkt-2-rgb.1";
		b2 = <&blinkt_leds>,"blinkt-2-rgb.2";

		r3 = <&blinkt_leds>,"blinkt-3-rgb.0";
		g3 = <&blinkt_leds>,"blinkt-3-rgb.1";
		b3 = <&blinkt_leds>,"blinkt-3-rgb.2";

		r4 = <&blinkt_leds>,"blinkt-4-rgb.0";
		g4 = <&blinkt_leds>,"blinkt-4-rgb.1";
		b4 = <&blinkt_leds>,"blinkt-4-rgb.2";

		r5 = <&blinkt_leds>,"blinkt-5-rgb.0";
		g5 = <&blinkt_leds>,"blinkt-5-rgb.1";
		b5 = <&blinkt_leds>,"blinkt-5-rgb.2";

		r6 = <&blinkt_leds>,"blinkt-6-rgb.0";
		g6 = <&blinkt_leds>,"blinkt-6-rgb.1";
		b6 = <&blinkt_leds>,"blinkt-6-rgb.2";

		r7 = <&blinkt_leds>,"blinkt-7-rgb.0";
		g7 = <&blinkt_leds>,"blinkt-7-rgb.1";
		b7 = <&blinkt_leds>,"blinkt-7-rgb.2";
	};
};
